## Kconfig
```kconfig
menu "Omni Configuration"

menu "System Options"

choice OMNI_LINKER_SCRIPT
    prompt "Linker Script Selection"
    default OMNI_LINKER_SCRIPT_SECTION_DEFAULT

    config OMNI_LINKER_SCRIPT_SECTION_DEFAULT
        bool "default"

    config OMNI_LINKER_SCRIPT_SECTION_CUSTOM
        bool "custom"

endchoice # OMNI_LINKER_SCRIPT

choice OMNI_RTOS
    prompt "RTOS Selection"
    default OMNI_RTOS_SECTION_FREERTOS

    config OMNI_RTOS_SECTION_NONE
        bool "none"

    config OMNI_RTOS_SECTION_FREERTOS
        bool "freertos"

endchoice # OMNI_RTOS

choice OMNI_USB
    prompt "USB Selection"
    default OMNI_USB_SECTION_CHERRYUSB

    config OMNI_USB_SECTION_NONE
        bool "none"

    config OMNI_USB_SECTION_CHERRYUSB
        bool "cherryusb"

endchoice # OMNI_USB

choice OMNI_SHELL
    prompt "Shell Selection"
    default OMNI_SHELL_SECTION_LETTER

    config OMNI_SHELL_SECTION_NONE
        bool "none"

    config OMNI_SHELL_SECTION_LETTER
        bool "letter"

endchoice # OMNI_SHELL

endmenu # System Options

    rsource "targets/Kconfig"
    rsource "boards/Kconfig"
    rsource "components/Kconfig"
    rsource "drivers/Kconfig"
    rsource "libraries/Kconfig"
endmenu # Omni Configuration
```

## boards/Kconfig
```kconfig
menu "Pheripherals Options"

############ STM32 Peripheral Selection ############

if OMNI_BOARD_SECTION_STM32F405RG
    menu "ST STM32F405RG"
        rsource "st/stm32f405rg/Kconfig"
    endmenu
endif # OMNI_BOARD_SECTION_STM32F405RG

if OMNI_BOARD_SECTION_STM32F407IG
    menu "ST STM32F407IG"
        rsource "st/stm32f407ig/Kconfig"
    endmenu
endif # OMNI_BOARD_SECTION_STM32F407IG

############ APM32 Peripheral Selection ############

if OMNI_BOARD_SECTION_APM32F405RG
    menu "APM APM32F405RG"
        rsource "apm/apm32f405rg/Kconfig"
    endmenu
endif # OMNI_BOARD_SECTION_APM32F405RG

if OMNI_BOARD_SECTION_APM32F407IG
    menu "APM APM32F407IG"
        rsource "apm/apm32f407ig/Kconfig"
    endmenu
endif # OMNI_BOARD_SECTION_APM32F407IG

endmenu # Boards Pheripherals Options
```

## boards/apm/apm32f405rg/Kconfig
```kconfig
menuconfig UART
    bool "UART board configuration"
    help
        Enable the UART board configuration.

if UART

menu "UART Port Configuration"
    config UART_NUM_1
        bool "Enable UART 1"
        default y
        help
            Enable UART 1 port.

    config UART_NUM_2
        bool "Enable UART 2"
        default n
        help
            Enable UART 2 port.

    config UART_NUM_3
        bool "Enable UART 3"
        default n
        help
            Enable UART 3 port.

    config UART_NUM_4
        bool "Enable UART 4"
        default n
        help
            Enable UART 4 port.

endmenu # UART Configuration

menu "UART IO Configuration"

    config UART1_TX_PIN
        depends on UART_NUM_1
        hex "UART 1 TX Pin"
        default 0x09
        help
            Set the UART 1 TX pin.

    config UART1_RX_PIN
        depends on UART_NUM_1
        hex "UART 1 RX Pin"
        default 0x0A
        help
            Set the UART 1 RX pin.

    config UART2_TX_PIN
        depends on UART_NUM_2
        hex "UART 2 TX Pin"
        default 0x02
        help
            Set the UART 2 TX pin.

    config UART2_RX_PIN
        depends on UART_NUM_2
        hex "UART 2 RX Pin"
        default 0x03
        help
            Set the UART 2 RX pin.

    config UART3_TX_PIN
        depends on UART_NUM_3
        hex "UART 3 TX Pin"
        default 0x1A
        help
            Set the UART 3 TX pin.

    config UART3_RX_PIN
        depends on UART_NUM_3
        hex "UART 3 RX Pin"
        default 0x1B
        help
            Set the UART 3 RX pin.

    config UART4_TX_PIN
        depends on UART_NUM_4
        hex "UART 4 TX Pin"
        default 0x2A
        help
            Set the UART 4 TX pin.

    config UART4_RX_PIN
        depends on UART_NUM_4
        hex "UART 4 RX Pin"
        default 0x2B
        help
            Set the UART 4 RX pin.

endmenu # UART IO Configuration

endif # UART
```

## boards/apm/apm32f407ig/Kconfig.i2c
```kconfig
menuconfig I2C
    bool "I2C board configuration"
    default y
    help
        Enable the I2C board configuration.

if I2C

menu "I2C Enable Configuration"

    config I2C_NUM_1
        bool "Enable I2C 1"
        default y
        help
            Enable I2C 1 port.

    config I2C_NUM_2
        bool "Enable I2C 2"
        default n
        help
            Enable I2C 2 port.

    config I2C_NUM_3
        bool "Enable I2C 3"
        default n
        help
            Enable I2C 3 port.

endmenu # I2C Enable Configuration

menu "I2C IO Configuration"

    menu "I2C1 IO"
        depends on I2C_NUM_1

        choice I2C1_SCL_PIN_SELECTION
            prompt "I2C1 SCL PIN"
            config I2C1_SCL_PIN_PB6
                bool "PB6"
            config I2C1_SCL_PIN_PB8
                bool "PB8"
        endchoice

        config I2C1_SCL_PIN
            hex
            default 0x16 if I2C1_SCL_PIN_PB6
            default 0x18 if I2C1_SCL_PIN_PB8
            depends on I2C_NUM_1
            help
                The hex value for the selected I2C1 SCL pin, based on user selection.

        choice I2C1_SDA_PIN_SELECTION
            prompt "I2C1 SDA PIN"
            config I2C1_SDA_PIN_PB7
                bool "PB7"
            config I2C1_SDA_PIN_PB9
                bool "PB9"
        endchoice

        config I2C1_SDA_PIN
            hex
            default 0x17 if I2C1_SDA_PIN_PB7
            default 0x19 if I2C1_SDA_PIN_PB9
            depends on I2C_NUM_1
            help
                The hex value for the selected I2C1 SDA pin, based on user selection.

        config I2C1_SCL_PIN_AF
            int
            default 4
            depends on I2C_NUM_1
            help
                Set the I2C1 SCL pin alternate function.

        config I2C1_SDA_PIN_AF
            int
            default 4
            depends on I2C_NUM_1
            help
                Set the I2C1 SDA pin alternate function.

    endmenu # I2C1 IO

    menu "I2C2 IO"
        depends on I2C_NUM_2

        choice I2C2_SCL_PIN_SELECTION
            prompt "I2C2 SCL PIN"
            config I2C2_SCL_PIN_PB10
                bool "PB10"
            config I2C2_SCL_PIN_PF1
                bool "PF1"
            config I2C2_SCL_PIN_PH4
                bool "PH4"
        endchoice

        config I2C2_SCL_PIN
            hex
            default 0x1A if I2C2_SCL_PIN_PB10
            default 0x51 if I2C2_SCL_PIN_PF1
            default 0x74 if I2C2_SCL_PIN_PH4
            depends on I2C_NUM_2
            help
                The hex value for the selected I2C2 SCL pin, based on user selection.

        choice I2C2_SDA_PIN_SELECTION
            prompt "I2C2 SDA PIN"
            config I2C2_SDA_PIN_PB11
                bool "PB11"
            config I2C2_SDA_PIN_PF0
                bool "PF0"
            config I2C2_SDA_PIN_PH5
                bool "PH5"
        endchoice

        config I2C2_SDA_PIN
            hex
            default 0x1B if I2C2_SDA_PIN_PB11
            default 0x50 if I2C2_SDA_PIN_PF0
            default 0x75 if I2C2_SDA_PIN_PH5
            depends on I2C_NUM_2
            help
                The hex value for the selected I2C2 SDA pin, based on user selection.

        config I2C2_SCL_PIN_AF
            int
            default 4
            depends on I2C_NUM_2
            help
                Set the I2C2 SCL pin alternate function.

        config I2C2_SDA_PIN_AF
            int
            default 4
            depends on I2C_NUM_2
            help
                Set the I2C2 SDA pin alternate function.

    endmenu # I2C2 IO

    menu "I2C3 IO"
        depends on I2C_NUM_3

        choice I2C3_SCL_PIN_SELECTION
            prompt "I2C3 SCL PIN"
            config I2C3_SCL_PIN_PA8
                bool "PA8"
            config I2C3_SCL_PIN_PH7
                bool "PH7"
        endchoice

        config I2C3_SCL_PIN
            hex
            default 0x08 if I2C3_SCL_PIN_PA8
            default 0x77 if I2C3_SCL_PIN_PH7
            depends on I2C_NUM_3
            help
                The hex value for the selected I2C3 SCL pin, based on user selection.

        choice I2C3_SDA_PIN_SELECTION
            prompt "I2C3 SDA PIN"
            config I2C3_SDA_PIN_PC9
                bool "PC9"
            config I2C3_SDA_PIN_PH8
                bool "PH8"
        endchoice

        config I2C3_SDA_PIN
            hex
            default 0x09 if I2C3_SDA_PIN_PC9
            default 0x78 if I2C3_SDA_PIN_PH8
            depends on I2C_NUM_3
            help
                The hex value for the selected I2C3 SDA pin, based on user selection.

        config I2C3_SCL_PIN_AF
            int
            default 4
            depends on I2C_NUM_3
            help
                Set the I2C3 SCL pin alternate function.

        config I2C3_SDA_PIN_AF
            int
            default 4
            depends on I2C_NUM_3
            help
                Set the I2C3 SDA pin alternate function.

    endmenu # I2C3 IO

endmenu # I2C IO Configuration

endif # I2C
```
